## layers/meta-balena-genericx86/conf/machine/genericx86-64.conf
```bitbake
#@TYPE: Machine
#@NAME: Generic x86_64
#@DESCRIPTION: Machine configuration for generic x86_64 (64-bit) PCs and servers. Supports a moderately wide range of drivers that should boot and be usable on "typical" hardware.

IMAGE_INSTALL:append = " nexcom"
```
